## layers/meta-balena-libretech-cc/conf/layer.conf
```bitbake
BBPATH .= ":${LAYERDIR}"

BBFILES += "${LAYERDIR}/recipes-*/*/*.bb \
            ${LAYERDIR}/recipes-*/*/*.bbappend"

BBFILE_COLLECTIONS += "balena-libretech-cc"
BBFILE_PATTERN_balena-libretech-cc := "^${LAYERDIR}/"
BBFILE_PRIORITY_balena-libretech-cc = "1337"

LAYERSERIES_COMPAT_balena-libretech-cc = "kirkstone"
```
